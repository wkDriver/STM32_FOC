//############################################################
// FILE: Timer.c
// Created on: 2017年1月11日
// Author: XQ
// summary: Timer
//  定时器1电机控制，正交编码器的定时器IO    
//本程序只供学习使用，未经作者许可，不得用于其它任何用途
//版权所有，盗版必究
//DSP/STM32电机控制开发板
//硕历电子
//网址: https://shuolidianzi.taobao.com
//修改日期:2017/1/24
//版本：V17.3-1
//Author-QQ: 616264123
//电机控制QQ群：314306105
//############################################################
#include "IQ_math.h"


const int16_t IQSin_Cos_Table[256]={\
0x0000,0x00C9,0x0192,0x025B,0x0324,0x03ED,0x04B6,0x057F,\
0x0648,0x0711,0x07D9,0x08A2,0x096A,0x0A33,0x0AFB,0x0BC4,\
0x0C8C,0x0D54,0x0E1C,0x0EE3,0x0FAB,0x1072,0x113A,0x1201,\
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0x7FD8,0x7FE1,0x7FE9,0x7FF0,0x7FF5,0x7FF9,0x7FFD,0x7FFE}; 

const int32_t IQAtan2_Table[256]={\
0x00000000,0x000000C9,0x00000192,0x0000025B,0x00000324,0x000003ED,0x000004B6,0x00000580,\
0x00000649,0x00000712,0x000008A7,0x00000971,0x00000A3B,0x00000B05,0x00000BD0,0x00000C9B,\
0x00000D66,0x00000E31,0x00000EFD,0x00000FC9,0x00001095,0x00001162,0x00001218,0x0000122F,\
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0x000A2D7F,0x000BA246,0x000D9338,0x00104AD7,0x00145E24,0x001B28CC,0x0028BDDA,0x00517C7E };
 
 
void  IQSin_Cos_Cale(p_IQSin_Cos  pV)  
{
  uint16_t  hindex;
  hindex = (uint16_t) pV->IQAngle; //-32768--- 32767 +32768===0--65535
  hindex >>=6;      //65536/64  ===1024/4=90度=256 0x01-0xFF  0X100  0X1FF  0X200 0X2FF    0X300  0X3FF
                                                      
  switch (hindex & SIN_RAD)  //  0X300  &   0x0000 -ff    0x0100  1ff   0X200    2ff   0x0300   3ff  
  {
    case U0_90:                        
       pV->IQSin = IQSin_Cos_Table[(uint8_t)(hindex)];  // 0---255  ==0---32766
       pV->IQCos = IQSin_Cos_Table[(uint8_t)(0xFF-(u8)(hindex))];
    break;
  
    case U90_180:  
       pV->IQSin = IQSin_Cos_Table[(u8)(0xFF-(u8)(hindex))]; // 255---0 == 0---32766 
       pV->IQCos = -IQSin_Cos_Table[(u8)(hindex)];
    break;
  
    case U180_270:
       pV->IQSin = -IQSin_Cos_Table[(u8)(hindex)];
       pV->IQCos = -IQSin_Cos_Table[(u8)(0xFF-(u8)(hindex))];
    break;
  
    case U270_360:
     pV->IQSin=  -IQSin_Cos_Table[(u8)(0xFF-(u8)(hindex))];
     pV->IQCos =  IQSin_Cos_Table[(u8)(hindex)]; 
    break;
   default:
    break;
  } 
} 
 
int32_t  IQsat( int32_t Uint,int32_t  U_max, int32_t U_min) 
{
	 int32_t Uout; 
 	if(Uint<= U_min)
		Uout= U_min;
	else if( Uint>=U_max)
		Uout=U_max;
	else
	  Uout= Uint;   
 
  return  Uout; 
}

void  IQAtan_Cale(p_IQAtan pV)  
{
  int16_t   i=0; 
    if( pV->Alpha == 0) 
    { 
        if (pV->Beta==0) 
					i =0; 
        else       
					i =255; 
    } 
    else 
    {  
      pV->IQTan = _IQdiv(Abs(pV->Alpha),Abs(pV->Beta)); 
 
			if (IQAtan2_Table[i + 128] <= pV->IQTan) i += 128; 
			if (IQAtan2_Table[i + 64] <= pV->IQTan) i += 64; 
			if (IQAtan2_Table[i + 32] <= pV->IQTan) i += 32; 
			if (IQAtan2_Table[i + 16] <= pV->IQTan) i += 16; 
			if (IQAtan2_Table[i + 8] <= pV->IQTan) i += 8; 
			if (IQAtan2_Table[i + 4] <= pV->IQTan) i += 4; 
			if (IQAtan2_Table[i + 2] <= pV->IQTan) i += 2; 
			if (IQAtan2_Table[i + 1] <= pV->IQTan) i += 1;    

		}
		
    if ( pV->Alpha> 0) 
    { 
        if (pV->Beta >0) 
           pV->IQAngle =i ;      
        else      
           pV->IQAngle= 512 -i;     
    } 
    else 
    {  
        if ( pV->Beta >0)
           pV->IQAngle= 1024-i;  
				else      
           pV->IQAngle =i+512; 	
    } 
     if( pV->IQAngle<0)
			 pV->IQAngle+=1024;
   pV->IQAngle= pV->IQAngle<<6;
	
}
 
 
uint32_t IQSqrt(uint32_t  M)
{
	uint32_t   N, i ,tmp  ,ttp;	
  if ( M==0 )
	  return 0;
	N=0;

  tmp=(M>>30);	

  M<<=2;
	if( tmp>1 )
	{
	  N++;
		tmp-=N;
	}	
	for (i=15;i>0;i--  )
	{
		N<<=1;
		
		tmp<<=2;
		tmp+=(M>>30);
		
		ttp=N;	
		ttp=(ttp<<1)+1;	
		
		M<<=2;
		if( tmp>= ttp )
		{
			 tmp-=ttp;
			 N++;
		}
	}	
	 return N;			
}

//===========================================================================
// No more.
//===========================================================================
